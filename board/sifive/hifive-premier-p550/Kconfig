## board/sifive/hifive-premier-p550/Kconfig
```kconfig
if TARGET_HIFIVE_PREMIER_P550

config SYS_BOARD
	default "hifive-premier-p550"

config SYS_CPU
	default "generic"

config SYS_VENDOR
	default "sifive"

config BOARD_SPECIFIC_OPTIONS # dummy
	def_bool y
	select GENERIC_RISCV
	select HAVE_MAP_NOCACHE
	select SUPPORT_SPL

endif
```

## configs/hifive-premier-p550_defconfig
```kconfig
CONFIG_RISCV=y
CONFIG_TEXT_BASE=0x80200000
CONFIG_ENV_SOURCE_FILE="hifive-premier-p550"
CONFIG_HAS_CUSTOM_SYS_INIT_SP_ADDR=y
CONFIG_CUSTOM_SYS_INIT_SP_ADDR=0x88000000
CONFIG_DM_GPIO=y
CONFIG_DEFAULT_DEVICE_TREE="eic7700-hifive-premier-p550"
CONFIG_DM_RESET=y
CONFIG_SPL_SYS_MALLOC_F_LEN=0x400000
CONFIG_SPL_TEXT_BASE=0x80000000
CONFIG_SPL_BSS_START_ADDR=0x88000000
CONFIG_SYS_LOAD_ADDR=0x84000000
CONFIG_SPL=y
CONFIG_TARGET_HIFIVE_PREMIER_P550=y
CONFIG_SPL_OPENSBI_LOAD_ADDR=0x80100000
CONFIG_NR_CPUS=4
CONFIG_ARCH_RV64I=y
CONFIG_RISCV_SMODE=y
CONFIG_FIT=y
CONFIG_SPL_LOAD_FIT_ADDRESS=0x84000000
CONFIG_BOOTSTD_DEFAULTS=y
CONFIG_SPL_MAX_SIZE=0x100000
CONFIG_SPL_PAD_TO=0x0
# CONFIG_SPL_RAW_IMAGE_SUPPORT is not set
CONFIG_SPL_YMODEM_SUPPORT=y
CONFIG_SPL_OPENSBI_SCRATCH_OPTIONS=0x0
CONFIG_OF_BOARD=y
CONFIG_DEVICE_TREE_INCLUDES="eic7700-u-boot.dtsi"
CONFIG_OF_SPL_REMOVE_PROPS=""
CONFIG_SIFIVE_CCACHE=y
CONFIG_SPL_CLK=y
CONFIG_CLK_ESWIN=y
CONFIG_CLK_ESWIN_EIC7700=y
CONFIG_DWAPB_GPIO=y
CONFIG_ESWIN_MFD=y
CONFIG_MMC=y
CONFIG_SUPPORT_EMMC_BOOT=y
CONFIG_MMC_SDHCI=y
CONFIG_PHY_REALTEK=y
CONFIG_DM_ETH_PHY=y
CONFIG_DWC_ETH_QOS=y
CONFIG_DWC_ETH_QOS_ESWIN=y
CONFIG_PINCTRL_EIC7700=y
CONFIG_DM_REGULATOR=y
CONFIG_DM_REGULATOR_FIXED=y
CONFIG_RESET_ESWIN=y
CONFIG_SYS_NS16550=y
CONFIG_SYS_NS16550_MEM32=y
CONFIG_SYSRESET=y
CONFIG_SPL_GZIP=y
```

## drivers/clk/eswin/Kconfig
```kconfig
config CLK_ESWIN
	bool "Clock support for ESWIN SoCs"
	depends on CLK
	help
	  Enable clock driver support for ESWIN platforms.

if CLK_ESWIN

config CLK_ESWIN_EIC7700
	bool "Clock driver for ESWIN EIC7700"
	help
	  Enable clock driver for the ESWIN EIC7700 SoC.

endif
```

## drivers/pinctrl/eswin/Kconfig
```kconfig
# SPDX-License-Identifier: GPL-2.0

config PINCTRL_EIC7700
	bool "Support for ESWIN EIC7700 pinctrl"
	select PINCTRL
	select PINCTRL_FULL
	select PINCTRL_GENERIC
	select PINCONF
	select PINMUX
```
